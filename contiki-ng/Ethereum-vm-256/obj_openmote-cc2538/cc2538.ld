



















       
       
       
       
       
       
       
       
       
       
       
       
       
       




















 
 
 
 
 
 
 
 






































 
 
 
   
   
 



















 
 
 



 
 
 
 
 
 
 
 
 











       






 
 
 
 
 
 
 
 
 
       
 
        
        
 
 
 
 
 
 
 
 
 
 
 
 
 
 




 
 
 


 
 
 



 
 
 
 
 
 
 
 
 
 
 
 
 
 
 
   
     
       
         
         
         
         
         
         
         
         
         
         
         
         
         
         
         
         
         
         
  
       
     
       
         
         
       
   
 
 
 
 
 

































 
 

















 





 
 
 
 
 




                       






















 
 







 
 
 















 
 
 
 
 




 

 









 
 
 


 
 
 
 


       








 
 
 













                             


 
 
 
 
 
 
 
 
 
 
 
 
 
 
 
 
 
 
 
 
 
 
 
 
 
 
 
 
 
 
 
 
 
 
 
 
 
 
 
 
 
 
 
 
 
 



 



 



 
 
 



 



 
 
 



 
 
 



 
 
 



 
 
 



 



 
 
 



 



 
 
 



 



 



 



 
 
 



 



 



 
 
 



 



 



 



 



 



 



 



 



 



 
 
 



 



 



 
  
 



   
  
  



   
  
  



   
  
  



  
  
  



  
  
  



  
  
  



 



 
 
 



   
  
  



   
  
  



   
  
  



  



  



  



 
 
   
   
   
   
   
   
 
 



 
 
   
   
 
 



 
 
   
   
   
   
   
   
   
   
   
 
 



 
 
   
   
   
 
 



 
       
 
       
 
       
 
       
 
       
 
       
 



 
 
 
 
 
 
 
 
 
 
 
 
 
 
 
 
 
 
 
       
 



       
 
 



 
 
 
 



 
 
   
   
   
 
       
 
       
 
       
 
       
 
 
 
       
 
 
       
 
 
 
 
 
 
 
 
 
 
 
 



 
 
 
 
 
 
 
 
 
 
 
       
 
 
 
       
 
 
 
       
 
 
 



 
 
       
 
       
 
       
 
 
 
       
 
 
 
       
 
 
 
       
 
 
       
 
 



 
 
 
 
 
 
 
 
 
 
 



 
 
 
 



 
 
 
 
 
               
               
 



 



 



 



 



 



 



 



 



 
 
   
 
 
 
   
 



 
 
   
 
 
 
   
 



 
 
 
 
 
 
          
          
        



 
 
 
 
 
 
 



 
 
                          
                           
 
 
 
   
 



 
 
   
 
 
 
 
 
                  
                  
 




 
     
 
   
   
     
   
   
 
 



 
 
 
   
   
 
 



 
 
   
 
 
 
   
 





 


 
 












                            





                          


 
 
 
 

MEMORY
{
    FLASH_FW (rx) : ORIGIN = (0x00200000 + (4 * 2048)), LENGTH = ((0x00200000 + (((((0) << 0 | (512) << 4 | (32) << 16 | ((1) ? 0x01000000 : 0) | ((1) ? 0x02000000 : 0)) & 0x0000FFF0) >> 4) << 10) - 0x0000002C) - (0x00200000 + (4 * 2048)))
    FLASH_CCA (RX) : ORIGIN = (0x00200000 + (((((0) << 0 | (512) << 4 | (32) << 16 | ((1) ? 0x01000000 : 0) | ((1) ? 0x02000000 : 0)) & 0x0000FFF0) >> 4) << 10) - 0x0000002C), LENGTH = 0x0000002C
    NRSRAM (RWX) : ORIGIN = 0x20000000, LENGTH = 0
    FRSRAM (RWX) : ORIGIN = (((((((0) << 0 | (512) << 4 | (32) << 16 | ((1) ? 0x01000000 : 0) | ((1) ? 0x02000000 : 0)) & 0x00FF0000) >> 16) << 10) - ((((((((0) << 0 | (512) << 4 | (32) << 16 | ((1) ? 0x01000000 : 0) | ((1) ? 0x02000000 : 0)) & 0x00FF0000) >> 16) << 10)) < (16384)) ? ((((((0) << 0 | (512) << 4 | (32) << 16 | ((1) ? 0x01000000 : 0) | ((1) ? 0x02000000 : 0)) & 0x00FF0000) >> 16) << 10)) : (16384))) ? 0x20000000 : 0x20004000), LENGTH = (((((0) << 0 | (512) << 4 | (32) << 16 | ((1) ? 0x01000000 : 0) | ((1) ? 0x02000000 : 0)) & 0x00FF0000) >> 16) << 10)
}
ENTRY(flash_cca_lock_page)
SECTIONS
{
    .text :
    {
        _text = .;
        *(.vectors)
        *(.text*)
        *(.rodata*)
        _etext = .;
    } > FLASH_FW= 0
    .socdata (NOLOAD) :
    {
        *(.udma_channel_control_table)
    } > FRSRAM
    .data : ALIGN(4)
    {
        _data = .;
        *(.data*)
        _edata = .;
    } > FRSRAM AT > FLASH_FW
    _ldata = LOADADDR(.data);
    .ARM.exidx :
    {
        *(.ARM.exidx*)
    } > FLASH_FW
    .bss :
    {
        _bss = .;
        *(.bss*)
        *(COMMON)
        _ebss = .;
    } > FRSRAM
    _end = .;
    _stack = .;
    .stack (NOLOAD) :
    {
        *(.stack)
    } > FRSRAM
    _stack_origin = .;
    _heap = .;
    _eheap = ORIGIN(FRSRAM) + LENGTH(FRSRAM);
    .nrdata (NOLOAD) :
    {
        _nrdata = .;
        *(.nrdata*)
        _enrdata = .;
    } > NRSRAM
    .flashcca :
    {
        *(.flashcca)
    } > FLASH_CCA
}
